/dts-v1/;

/ {
    model = "Qualcomm Technologies, Inc. MSM sdm845 V2 MTP";
    compatible = "qcom,sdm845";
    qcom,msm-id = <321 0x20000>;
    qcom,board-id = <8 0>;
    qcom,pmic-id = <0x20014 0x20115 0x20018 0x0>;	

    chosen {
	linux,initrd-end = <0x0 0xA3E01000>;
	linux,initrd-start = <0x0 0xA3400000>;
        bootargs = "TERM=uart";
    };

    // empty node needed to make fastboot happy
    memory {
	   reg = <0x0 0xA0000000 0x0 0x7800000>; //120 MB
    };
};
